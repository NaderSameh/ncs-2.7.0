## zephyr/samples/modem_test/build/Kconfig/Kconfig.shield
```kconfig
osource "C:/Users/NSameh/Desktop/zephyr/ncs-2.7.0/nrf/boards/shields/*/Kconfig.shield"
```

## zephyr/samples/modem_test/build/Kconfig/arch/Kconfig
```kconfig
# Load arch Kconfig descriptions.
osource "C:/Users/NSameh/Desktop/zephyr/ncs-2.7.0/zephyr/arch/x86/Kconfig"
osource "C:/Users/NSameh/Desktop/zephyr/ncs-2.7.0/zephyr/arch/xtensa/Kconfig"
osource "C:/Users/NSameh/Desktop/zephyr/ncs-2.7.0/zephyr/arch/sparc/Kconfig"
osource "C:/Users/NSameh/Desktop/zephyr/ncs-2.7.0/zephyr/arch/riscv/Kconfig"
osource "C:/Users/NSameh/Desktop/zephyr/ncs-2.7.0/zephyr/arch/posix/Kconfig"
osource "C:/Users/NSameh/Desktop/zephyr/ncs-2.7.0/zephyr/arch/nios2/Kconfig"
osource "C:/Users/NSameh/Desktop/zephyr/ncs-2.7.0/zephyr/arch/mips/Kconfig"
osource "C:/Users/NSameh/Desktop/zephyr/ncs-2.7.0/zephyr/arch/arm64/Kconfig"
osource "C:/Users/NSameh/Desktop/zephyr/ncs-2.7.0/zephyr/arch/arm/Kconfig"
osource "C:/Users/NSameh/Desktop/zephyr/ncs-2.7.0/zephyr/arch/arc/Kconfig"
```
