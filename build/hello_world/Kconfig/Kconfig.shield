## zephyr/boards/nordic/nrf52840dk-tracker/Kconfig.defconfig
```kconfig
# nRF52840 DK NRF52840 board configuration

# Copyright (c) 2016 Nordic Semiconductor ASA
# SPDX-License-Identifier: Apache-2.0

if BOARD_CYTRACKER

config BT_CTLR
	default BT

endif # BOARD_CYTRACKER
```

## zephyr/boards/nordic/nrf52840dk-tracker/board.yml
```yaml
board:
  name: nrf52840dk_tracker
  vendor: nordic
  socs:
  # Physical nRF52840 SoC on PCA10056
  - name: nrf52840
```

## zephyr/samples/basic/button/boards/arm/nrf52dk_nrf52832_CyLock/nrf52dk_nrf52832_CyLock_defconfig
```kconfig
# SPDX-License-Identifier: Apache-2.0

CONFIG_SOC_SERIES_NRF52X=y
CONFIG_SOC_NRF52832_QFAA=y
CONFIG_BOARD_NRF52DK_NRF52832=y

# Enable MPU
CONFIG_ARM_MPU=y

# Enable hardware stack protection
CONFIG_HW_STACK_PROTECTION=y

# Enable RTT
CONFIG_USE_SEGGER_RTT=y

# enable GPIO
CONFIG_GPIO=y

# enable uart driver
CONFIG_SERIAL=y

# enable console
CONFIG_CONSOLE=y
CONFIG_UART_CONSOLE=n

# additional board options
CONFIG_GPIO_AS_PINRESET=n

CONFIG_PINCTRL=y

CONFIG_RTT_CONSOLE=y
CONFIG_BOARD_ENABLE_DCDC=n
CONFIG_CLOCK_CONTROL=y
CONFIG_CLOCK_CONTROL_NRF=y
# CONFIG_CLOCK_CONTROL_NRF_SOURCE=y
CONFIG_CLOCK_CONTROL_NRF_K32SRC_RC=y
CONFIG_CLOCK_CONTROL_NRF_K32SRC_RC_CALIBRATION=y
CONFIG_CLOCK_CONTROL_NRF_K32SRC_XTAL=n
```

## zephyr/samples/boards/nrf/system_off/boards/arm/cytracker/Kconfig.board
```kconfig
# Copyright (c) 2024 Nordic Semiconductor ASA
# SPDX-License-Identifier: Apache-2.0

config BOARD_CYTRACKER
	bool "CyTracker"
	depends on SOC_NRF52840_QIAA
```

## zephyr/samples/boards/nrf/system_off/boards/arm/cytracker/Kconfig.defconfig
```kconfig
# Copyright (c) 2024 Nordic Semiconductor ASA
# SPDX-License-Identifier: Apache-2.0

if BOARD_CYTRACKER

config BOARD
	default "cytracker"

config BT_CTLR
   default BT

endif
```

## zephyr/samples/hello_world/build/Kconfig/Kconfig.shield
```kconfig
osource "d:/ncs-d/cylockv2i7.2/boards/shields/*/Kconfig.shield"
osource "d:/ncs-d/cytrackerv1.1/cylockv2i7.2/boards/shields/*/Kconfig.shield"
osource "d:/ncs-d/thurayagateway/boards/shields/*/Kconfig.shield"
osource "d:/ncs-d/beacon-tag/boards/shields/*/Kconfig.shield"
osource "d:/ncs-d/v2.7.0-rc3/zephyr/samples/hello_world/boards/shields/*/Kconfig.shield"
osource "D:/ncs-D/v2.7.0-rc3/nrf/boards/shields/*/Kconfig.shield"
```

## zephyr/samples/hello_world/build/Kconfig/Kconfig.shield.defconfig
```kconfig
osource "d:/ncs-d/cylockv2i7.2/boards/shields/*/Kconfig.defconfig"
osource "d:/ncs-d/cytrackerv1.1/cylockv2i7.2/boards/shields/*/Kconfig.defconfig"
osource "d:/ncs-d/thurayagateway/boards/shields/*/Kconfig.defconfig"
osource "d:/ncs-d/beacon-tag/boards/shields/*/Kconfig.defconfig"
osource "d:/ncs-d/v2.7.0-rc3/zephyr/samples/hello_world/boards/shields/*/Kconfig.defconfig"
osource "D:/ncs-D/v2.7.0-rc3/nrf/boards/shields/*/Kconfig.defconfig"
```

## zephyr/samples/hello_world/build/Kconfig/soc/Kconfig.soc
```kconfig
# Load SoC Kconfig descriptions.
osource "D:/ncs-D/v2.7.0-rc3/zephyr/soc/xlnx/zynqmp/Kconfig.soc"
osource "D:/ncs-D/v2.7.0-rc3/zephyr/soc/xlnx/zynq7000/Kconfig.soc"
osource "D:/ncs-D/v2.7.0-rc3/zephyr/soc/xen/Kconfig.soc"
osource "D:/ncs-D/v2.7.0-rc3/zephyr/soc/ti/simplelink/Kconfig.soc"
osource "D:/ncs-D/v2.7.0-rc3/zephyr/soc/ti/lm3s6965/Kconfig.soc"
osource "D:/ncs-D/v2.7.0-rc3/zephyr/soc/ti/k3/Kconfig.soc"
osource "D:/ncs-D/v2.7.0-rc3/zephyr/soc/telink/tlsr/Kconfig.soc"
osource "D:/ncs-D/v2.7.0-rc3/zephyr/soc/starfive/jh71xx/Kconfig.soc"
osource "D:/ncs-D/v2.7.0-rc3/zephyr/soc/st/stm32/Kconfig.soc"
osource "D:/ncs-D/v2.7.0-rc3/zephyr/soc/snps/qemu_arc/Kconfig.soc"
osource "D:/ncs-D/v2.7.0-rc3/zephyr/soc/snps/nsim/Kconfig.soc"
osource "D:/ncs-D/v2.7.0-rc3/zephyr/soc/snps/hsdk4xd/Kconfig.soc"
osource "D:/ncs-D/v2.7.0-rc3/zephyr/soc/snps/hsdk/Kconfig.soc"
osource "D:/ncs-D/v2.7.0-rc3/zephyr/soc/snps/emsk/Kconfig.soc"
osource "D:/ncs-D/v2.7.0-rc3/zephyr/soc/snps/emsdp/Kconfig.soc"
osource "D:/ncs-D/v2.7.0-rc3/zephyr/soc/snps/arc_iot/Kconfig.soc"
osource "D:/ncs-D/v2.7.0-rc3/zephyr/soc/silabs/Kconfig.soc"
osource "D:/ncs-D/v2.7.0-rc3/zephyr/soc/sifive/sifive_freedom/Kconfig.soc"
osource "D:/ncs-D/v2.7.0-rc3/zephyr/soc/rockchip/Kconfig.soc"
osource "D:/ncs-D/v2.7.0-rc3/zephyr/soc/renode/riscv_virtual/Kconfig.soc"
osource "D:/ncs-D/v2.7.0-rc3/zephyr/soc/renesas/smartbond/Kconfig.soc"
osource "D:/ncs-D/v2.7.0-rc3/zephyr/soc/renesas/rzt2m/Kconfig.soc"
osource "D:/ncs-D/v2.7.0-rc3/zephyr/soc/renesas/rcar/Kconfig.soc"
osource "D:/ncs-D/v2.7.0-rc3/zephyr/soc/renesas/ra/Kconfig.soc"
osource "D:/ncs-D/v2.7.0-rc3/zephyr/soc/raspberrypi/Kconfig.soc"
osource "D:/ncs-D/v2.7.0-rc3/zephyr/soc/quicklogic/eos_s3/Kconfig.soc"
osource "D:/ncs-D/v2.7.0-rc3/zephyr/soc/qemu/virt_riscv/Kconfig.soc"
osource "D:/ncs-D/v2.7.0-rc3/zephyr/soc/qemu/malta/Kconfig.soc"
osource "D:/ncs-D/v2.7.0-rc3/zephyr/soc/openisa/rv32m1/Kconfig.soc"
osource "D:/ncs-D/v2.7.0-rc3/zephyr/soc/nxp/s32/Kconfig.soc"
osource "D:/ncs-D/v2.7.0-rc3/zephyr/soc/nxp/rw/Kconfig.soc"
osource "D:/ncs-D/v2.7.0-rc3/zephyr/soc/nxp/mcx/Kconfig.soc"
osource "D:/ncs-D/v2.7.0-rc3/zephyr/soc/nxp/lpc/Kconfig.soc"
osource "D:/ncs-D/v2.7.0-rc3/zephyr/soc/nxp/layerscape/Kconfig.soc"
osource "D:/ncs-D/v2.7.0-rc3/zephyr/soc/nxp/kinetis/Kconfig.soc"
osource "D:/ncs-D/v2.7.0-rc3/zephyr/soc/nxp/imxrt/Kconfig.soc"
osource "D:/ncs-D/v2.7.0-rc3/zephyr/soc/nxp/imx/Kconfig.soc"
osource "D:/ncs-D/v2.7.0-rc3/zephyr/soc/nuvoton/numicro/Kconfig.soc"
osource "D:/ncs-D/v2.7.0-rc3/zephyr/soc/nuvoton/numaker/Kconfig.soc"
osource "D:/ncs-D/v2.7.0-rc3/zephyr/soc/nuvoton/npcx/Kconfig.soc"
osource "D:/ncs-D/v2.7.0-rc3/zephyr/soc/nordic/Kconfig.soc"
osource "D:/ncs-D/v2.7.0-rc3/zephyr/soc/neorv32/Kconfig.soc"
osource "D:/ncs-D/v2.7.0-rc3/zephyr/soc/native/inf_clock/Kconfig.soc"
osource "D:/ncs-D/v2.7.0-rc3/zephyr/soc/microchip/miv/Kconfig.soc"
osource "D:/ncs-D/v2.7.0-rc3/zephyr/soc/microchip/mec/Kconfig.soc"
osource "D:/ncs-D/v2.7.0-rc3/zephyr/soc/lowrisc/opentitan/Kconfig.soc"
osource "D:/ncs-D/v2.7.0-rc3/zephyr/soc/litex/litex_vexriscv/Kconfig.soc"
osource "D:/ncs-D/v2.7.0-rc3/zephyr/soc/ite/ec/Kconfig.soc"
osource "D:/ncs-D/v2.7.0-rc3/zephyr/soc/intel/raptor_lake/Kconfig.soc"
osource "D:/ncs-D/v2.7.0-rc3/zephyr/soc/intel/lakemont/Kconfig.soc"
osource "D:/ncs-D/v2.7.0-rc3/zephyr/soc/intel/intel_socfpga_std/Kconfig.soc"
osource "D:/ncs-D/v2.7.0-rc3/zephyr/soc/intel/intel_socfpga/Kconfig.soc"
osource "D:/ncs-D/v2.7.0-rc3/zephyr/soc/intel/intel_niosv/Kconfig.soc"
osource "D:/ncs-D/v2.7.0-rc3/zephyr/soc/intel/intel_ish/Kconfig.soc"
osource "D:/ncs-D/v2.7.0-rc3/zephyr/soc/intel/intel_adsp/Kconfig.soc"
osource "D:/ncs-D/v2.7.0-rc3/zephyr/soc/intel/elkhart_lake/Kconfig.soc"
osource "D:/ncs-D/v2.7.0-rc3/zephyr/soc/intel/atom/Kconfig.soc"
osource "D:/ncs-D/v2.7.0-rc3/zephyr/soc/intel/apollo_lake/Kconfig.soc"
osource "D:/ncs-D/v2.7.0-rc3/zephyr/soc/intel/alder_lake/Kconfig.soc"
osource "D:/ncs-D/v2.7.0-rc3/zephyr/soc/infineon/cat3/Kconfig.soc"
osource "D:/ncs-D/v2.7.0-rc3/zephyr/soc/infineon/cat1a/Kconfig.soc"
osource "D:/ncs-D/v2.7.0-rc3/zephyr/soc/gd/gd32/Kconfig.soc"
osource "D:/ncs-D/v2.7.0-rc3/zephyr/soc/gaisler/leon3/Kconfig.soc"
osource "D:/ncs-D/v2.7.0-rc3/zephyr/soc/gaisler/gr716a/Kconfig.soc"
osource "D:/ncs-D/v2.7.0-rc3/zephyr/soc/espressif/Kconfig.soc"
osource "D:/ncs-D/v2.7.0-rc3/zephyr/soc/ene/kb1200/Kconfig.soc"
osource "D:/ncs-D/v2.7.0-rc3/zephyr/soc/efinix/sapphire/Kconfig.soc"
osource "D:/ncs-D/v2.7.0-rc3/zephyr/soc/cdns/xtensa_sample_controller/Kconfig.soc"
osource "D:/ncs-D/v2.7.0-rc3/zephyr/soc/cdns/dc233c/Kconfig.soc"
osource "D:/ncs-D/v2.7.0-rc3/zephyr/soc/brcm/bcmvk/Kconfig.soc"
osource "D:/ncs-D/v2.7.0-rc3/zephyr/soc/brcm/bcm2712/Kconfig.soc"
osource "D:/ncs-D/v2.7.0-rc3/zephyr/soc/brcm/bcm2711/Kconfig.soc"
osource "D:/ncs-D/v2.7.0-rc3/zephyr/soc/atmel/sam0/Kconfig.soc"
osource "D:/ncs-D/v2.7.0-rc3/zephyr/soc/atmel/sam/Kconfig.soc"
osource "D:/ncs-D/v2.7.0-rc3/zephyr/soc/aspeed/Kconfig.soc"
osource "D:/ncs-D/v2.7.0-rc3/zephyr/soc/arm/Kconfig.soc"
osource "D:/ncs-D/v2.7.0-rc3/zephyr/soc/arm/beetle/Kconfig.soc"
osource "D:/ncs-D/v2.7.0-rc3/zephyr/soc/andestech/Kconfig.soc"
osource "D:/ncs-D/v2.7.0-rc3/zephyr/soc/ambiq/Kconfig.soc"
osource "D:/ncs-D/v2.7.0-rc3/zephyr/soc/altr/zephyr_nios2f/Kconfig.soc"
osource "D:/ncs-D/v2.7.0-rc3/zephyr/soc/altr/qemu_nios2/Kconfig.soc"
```

## zephyr/samples/modem_test/build/Kconfig/soc/Kconfig
```kconfig
# Load Zephyr SoC Kconfig descriptions.
osource "D:/ncs-D/v2.7.0-rc3/zephyr/soc/xlnx/zynqmp/Kconfig"
osource "D:/ncs-D/v2.7.0-rc3/zephyr/soc/xlnx/zynq7000/Kconfig"
osource "D:/ncs-D/v2.7.0-rc3/zephyr/soc/xen/Kconfig"
osource "D:/ncs-D/v2.7.0-rc3/zephyr/soc/ti/simplelink/Kconfig"
osource "D:/ncs-D/v2.7.0-rc3/zephyr/soc/ti/lm3s6965/Kconfig"
osource "D:/ncs-D/v2.7.0-rc3/zephyr/soc/ti/k3/Kconfig"
osource "D:/ncs-D/v2.7.0-rc3/zephyr/soc/telink/tlsr/Kconfig"
osource "D:/ncs-D/v2.7.0-rc3/zephyr/soc/starfive/jh71xx/Kconfig"
osource "D:/ncs-D/v2.7.0-rc3/zephyr/soc/st/stm32/Kconfig"
osource "D:/ncs-D/v2.7.0-rc3/zephyr/soc/snps/qemu_arc/Kconfig"
osource "D:/ncs-D/v2.7.0-rc3/zephyr/soc/snps/nsim/Kconfig"
osource "D:/ncs-D/v2.7.0-rc3/zephyr/soc/snps/hsdk4xd/Kconfig"
osource "D:/ncs-D/v2.7.0-rc3/zephyr/soc/snps/hsdk/Kconfig"
osource "D:/ncs-D/v2.7.0-rc3/zephyr/soc/snps/emsk/Kconfig"
osource "D:/ncs-D/v2.7.0-rc3/zephyr/soc/snps/emsdp/Kconfig"
osource "D:/ncs-D/v2.7.0-rc3/zephyr/soc/snps/arc_iot/Kconfig"
osource "D:/ncs-D/v2.7.0-rc3/zephyr/soc/silabs/Kconfig"
osource "D:/ncs-D/v2.7.0-rc3/zephyr/soc/sifive/sifive_freedom/Kconfig"
osource "D:/ncs-D/v2.7.0-rc3/zephyr/soc/rockchip/Kconfig"
osource "D:/ncs-D/v2.7.0-rc3/zephyr/soc/renode/riscv_virtual/Kconfig"
osource "D:/ncs-D/v2.7.0-rc3/zephyr/soc/renesas/smartbond/Kconfig"
osource "D:/ncs-D/v2.7.0-rc3/zephyr/soc/renesas/rzt2m/Kconfig"
osource "D:/ncs-D/v2.7.0-rc3/zephyr/soc/renesas/rcar/Kconfig"
osource "D:/ncs-D/v2.7.0-rc3/zephyr/soc/renesas/ra/Kconfig"
osource "D:/ncs-D/v2.7.0-rc3/zephyr/soc/raspberrypi/Kconfig"
osource "D:/ncs-D/v2.7.0-rc3/zephyr/soc/quicklogic/eos_s3/Kconfig"
osource "D:/ncs-D/v2.7.0-rc3/zephyr/soc/qemu/virt_riscv/Kconfig"
osource "D:/ncs-D/v2.7.0-rc3/zephyr/soc/qemu/malta/Kconfig"
osource "D:/ncs-D/v2.7.0-rc3/zephyr/soc/openisa/rv32m1/Kconfig"
osource "D:/ncs-D/v2.7.0-rc3/zephyr/soc/nxp/s32/Kconfig"
osource "D:/ncs-D/v2.7.0-rc3/zephyr/soc/nxp/rw/Kconfig"
osource "D:/ncs-D/v2.7.0-rc3/zephyr/soc/nxp/mcx/Kconfig"
osource "D:/ncs-D/v2.7.0-rc3/zephyr/soc/nxp/lpc/Kconfig"
osource "D:/ncs-D/v2.7.0-rc3/zephyr/soc/nxp/layerscape/Kconfig"
osource "D:/ncs-D/v2.7.0-rc3/zephyr/soc/nxp/kinetis/Kconfig"
osource "D:/ncs-D/v2.7.0-rc3/zephyr/soc/nxp/imxrt/Kconfig"
osource "D:/ncs-D/v2.7.0-rc3/zephyr/soc/nxp/imx/Kconfig"
osource "D:/ncs-D/v2.7.0-rc3/zephyr/soc/nuvoton/numicro/Kconfig"
osource "D:/ncs-D/v2.7.0-rc3/zephyr/soc/nuvoton/numaker/Kconfig"
osource "D:/ncs-D/v2.7.0-rc3/zephyr/soc/nuvoton/npcx/Kconfig"
osource "D:/ncs-D/v2.7.0-rc3/zephyr/soc/nordic/Kconfig"
osource "D:/ncs-D/v2.7.0-rc3/zephyr/soc/neorv32/Kconfig"
osource "D:/ncs-D/v2.7.0-rc3/zephyr/soc/native/inf_clock/Kconfig"
osource "D:/ncs-D/v2.7.0-rc3/zephyr/soc/microchip/miv/Kconfig"
osource "D:/ncs-D/v2.7.0-rc3/zephyr/soc/microchip/mec/Kconfig"
osource "D:/ncs-D/v2.7.0-rc3/zephyr/soc/lowrisc/opentitan/Kconfig"
osource "D:/ncs-D/v2.7.0-rc3/zephyr/soc/litex/litex_vexriscv/Kconfig"
osource "D:/ncs-D/v2.7.0-rc3/zephyr/soc/ite/ec/Kconfig"
osource "D:/ncs-D/v2.7.0-rc3/zephyr/soc/intel/raptor_lake/Kconfig"
osource "D:/ncs-D/v2.7.0-rc3/zephyr/soc/intel/lakemont/Kconfig"
osource "D:/ncs-D/v2.7.0-rc3/zephyr/soc/intel/intel_socfpga_std/Kconfig"
osource "D:/ncs-D/v2.7.0-rc3/zephyr/soc/intel/intel_socfpga/Kconfig"
osource "D:/ncs-D/v2.7.0-rc3/zephyr/soc/intel/intel_niosv/Kconfig"
osource "D:/ncs-D/v2.7.0-rc3/zephyr/soc/intel/intel_ish/Kconfig"
osource "D:/ncs-D/v2.7.0-rc3/zephyr/soc/intel/intel_adsp/Kconfig"
osource "D:/ncs-D/v2.7.0-rc3/zephyr/soc/intel/elkhart_lake/Kconfig"
osource "D:/ncs-D/v2.7.0-rc3/zephyr/soc/intel/atom/Kconfig"
osource "D:/ncs-D/v2.7.0-rc3/zephyr/soc/intel/apollo_lake/Kconfig"
osource "D:/ncs-D/v2.7.0-rc3/zephyr/soc/intel/alder_lake/Kconfig"
osource "D:/ncs-D/v2.7.0-rc3/zephyr/soc/infineon/cat3/Kconfig"
osource "D:/ncs-D/v2.7.0-rc3/zephyr/soc/infineon/cat1a/Kconfig"
osource "D:/ncs-D/v2.7.0-rc3/zephyr/soc/gd/gd32/Kconfig"
osource "D:/ncs-D/v2.7.0-rc3/zephyr/soc/gaisler/leon3/Kconfig"
osource "D:/ncs-D/v2.7.0-rc3/zephyr/soc/gaisler/gr716a/Kconfig"
osource "D:/ncs-D/v2.7.0-rc3/zephyr/soc/espressif/Kconfig"
osource "D:/ncs-D/v2.7.0-rc3/zephyr/soc/ene/kb1200/Kconfig"
osource "D:/ncs-D/v2.7.0-rc3/zephyr/soc/efinix/sapphire/Kconfig"
osource "D:/ncs-D/v2.7.0-rc3/zephyr/soc/cdns/xtensa_sample_controller/Kconfig"
osource "D:/ncs-D/v2.7.0-rc3/zephyr/soc/cdns/dc233c/Kconfig"
osource "D:/ncs-D/v2.7.0-rc3/zephyr/soc/brcm/bcmvk/Kconfig"
osource "D:/ncs-D/v2.7.0-rc3/zephyr/soc/brcm/bcm2712/Kconfig"
osource "D:/ncs-D/v2.7.0-rc3/zephyr/soc/brcm/bcm2711/Kconfig"
osource "D:/ncs-D/v2.7.0-rc3/zephyr/soc/atmel/sam0/Kconfig"
osource "D:/ncs-D/v2.7.0-rc3/zephyr/soc/atmel/sam/Kconfig"
osource "D:/ncs-D/v2.7.0-rc3/zephyr/soc/aspeed/Kconfig"
osource "D:/ncs-D/v2.7.0-rc3/zephyr/soc/arm/Kconfig"
osource "D:/ncs-D/v2.7.0-rc3/zephyr/soc/arm/beetle/Kconfig"
osource "D:/ncs-D/v2.7.0-rc3/zephyr/soc/andestech/Kconfig"
osource "D:/ncs-D/v2.7.0-rc3/zephyr/soc/ambiq/Kconfig"
osource "D:/ncs-D/v2.7.0-rc3/zephyr/soc/altr/zephyr_nios2f/Kconfig"
osource "D:/ncs-D/v2.7.0-rc3/zephyr/soc/altr/qemu_nios2/Kconfig"
```

## zephyr/samples/modem_test/build_1/Kconfig/Kconfig.shield
```kconfig
osource "d:/ncs-d/v2.7.0-rc3/zephyr/samples/modem_test/boards/shields/*/Kconfig.shield"
osource "d:/ncs-d/cylockv2i7.2/boards/shields/*/Kconfig.shield"
osource "D:/ncs-D/v2.7.0-rc3/nrf/boards/shields/*/Kconfig.shield"
```

## zephyr/samples/modem_test/build_1/Kconfig/Kconfig.shield.defconfig
```kconfig
osource "d:/ncs-d/v2.7.0-rc3/zephyr/samples/modem_test/boards/shields/*/Kconfig.defconfig"
osource "d:/ncs-d/cylockv2i7.2/boards/shields/*/Kconfig.defconfig"
osource "D:/ncs-D/v2.7.0-rc3/nrf/boards/shields/*/Kconfig.defconfig"
```
